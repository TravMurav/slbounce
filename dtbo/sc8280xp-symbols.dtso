// SPDX-License-Identifier: BSD-3-Clause

/dts-v1/;
/plugin/;

/*
 * This is a funny hack to allow phandles on top of a dtb without --symbols
 */
&{/} {
	__symbols__ {
		xo_board_clk = "/clocks/xo-board-clk";
		sleep_clk = "/clocks/sleep-clk";
		CPU0 = "/cpus/cpu@0";
		L2_0 = "/cpus/cpu@0/l2-cache";
		L3_0 = "/cpus/cpu@0/l2-cache/l3-cache";
		CPU1 = "/cpus/cpu@100";
		L2_100 = "/cpus/cpu@100/l2-cache";
		CPU2 = "/cpus/cpu@200";
		L2_200 = "/cpus/cpu@200/l2-cache";
		CPU3 = "/cpus/cpu@300";
		L2_300 = "/cpus/cpu@300/l2-cache";
		CPU4 = "/cpus/cpu@400";
		L2_400 = "/cpus/cpu@400/l2-cache";
		CPU5 = "/cpus/cpu@500";
		L2_500 = "/cpus/cpu@500/l2-cache";
		CPU6 = "/cpus/cpu@600";
		L2_600 = "/cpus/cpu@600/l2-cache";
		CPU7 = "/cpus/cpu@700";
		L2_700 = "/cpus/cpu@700/l2-cache";
		LITTLE_CPU_SLEEP_0 = "/cpus/idle-states/cpu-sleep-0-0";
		BIG_CPU_SLEEP_0 = "/cpus/idle-states/cpu-sleep-1-0";
		CLUSTER_SLEEP_0 = "/cpus/domain-idle-states/cluster-sleep-0";
		scm = "/firmware/scm";
		aggre1_noc = "/interconnect-aggre1-noc";
		aggre2_noc = "/interconnect-aggre2-noc";
		clk_virt = "/interconnect-clk-virt";
		config_noc = "/interconnect-config-noc";
		dc_noc = "/interconnect-dc-noc";
		gem_noc = "/interconnect-gem-noc";
		lpass_noc = "/interconnect-lpass-ag-noc";
		mc_virt = "/interconnect-mc-virt";
		mmss_noc = "/interconnect-mmss-noc";
		nspa_noc = "/interconnect-nspa-noc";
		nspb_noc = "/interconnect-nspb-noc";
		system_noc = "/interconnect-system-noc";
		cpu0_opp_table = "/opp-table-cpu0";
		cpu4_opp_table = "/opp-table-cpu4";
		qup_opp_table_100mhz = "/opp-table-qup100mhz";
		CPU_PD0 = "/psci/power-domain-cpu0";
		CPU_PD1 = "/psci/power-domain-cpu1";
		CPU_PD2 = "/psci/power-domain-cpu2";
		CPU_PD3 = "/psci/power-domain-cpu3";
		CPU_PD4 = "/psci/power-domain-cpu4";
		CPU_PD5 = "/psci/power-domain-cpu5";
		CPU_PD6 = "/psci/power-domain-cpu6";
		CPU_PD7 = "/psci/power-domain-cpu7";
		CLUSTER_PD = "/psci/power-domain-cpu-cluster0";
		cmd_db = "/reserved-memory/cmd-db-region@80860000";
		smem_mem = "/reserved-memory/smem-region@80900000";
		pil_adsp_mem = "/reserved-memory/adsp-region@86c00000";
		pil_nsp0_mem = "/reserved-memory/cdsp0-region@8a100000";
		pil_nsp1_mem = "/reserved-memory/cdsp1-region@8c600000";
		gpu_mem = "/reserved-memory/gpu-mem@8bf00000";
		smp2p_adsp_out = "/smp2p-adsp/master-kernel";
		smp2p_adsp_in = "/smp2p-adsp/slave-kernel";
		smp2p_nsp0_out = "/smp2p-nsp0/master-kernel";
		smp2p_nsp0_in = "/smp2p-nsp0/slave-kernel";
		smp2p_nsp1_out = "/smp2p-nsp1/master-kernel";
		smp2p_nsp1_in = "/smp2p-nsp1/slave-kernel";
		soc = "/soc@0";
		ethernet0 = "/soc@0/ethernet@20000";
		gcc = "/soc@0/clock-controller@100000";
		ipcc = "/soc@0/mailbox@408000";
		qup2 = "/soc@0/geniqup@8c0000";
		i2c16 = "/soc@0/geniqup@8c0000/i2c@880000";
		spi16 = "/soc@0/geniqup@8c0000/spi@880000";
		i2c17 = "/soc@0/geniqup@8c0000/i2c@884000";
		spi17 = "/soc@0/geniqup@8c0000/spi@884000";
		uart17 = "/soc@0/geniqup@8c0000/serial@884000";
		i2c18 = "/soc@0/geniqup@8c0000/i2c@888000";
		spi18 = "/soc@0/geniqup@8c0000/spi@888000";
		i2c19 = "/soc@0/geniqup@8c0000/i2c@88c000";
		spi19 = "/soc@0/geniqup@8c0000/spi@88c000";
		i2c20 = "/soc@0/geniqup@8c0000/i2c@890000";
		spi20 = "/soc@0/geniqup@8c0000/spi@890000";
		i2c21 = "/soc@0/geniqup@8c0000/i2c@894000";
		spi21 = "/soc@0/geniqup@8c0000/spi@894000";
		i2c22 = "/soc@0/geniqup@8c0000/i2c@898000";
		spi22 = "/soc@0/geniqup@8c0000/spi@898000";
		i2c23 = "/soc@0/geniqup@8c0000/i2c@89c000";
		spi23 = "/soc@0/geniqup@8c0000/spi@89c000";
		qup0 = "/soc@0/geniqup@9c0000";
		i2c0 = "/soc@0/geniqup@9c0000/i2c@980000";
		spi0 = "/soc@0/geniqup@9c0000/spi@980000";
		i2c1 = "/soc@0/geniqup@9c0000/i2c@984000";
		spi1 = "/soc@0/geniqup@9c0000/spi@984000";
		i2c2 = "/soc@0/geniqup@9c0000/i2c@988000";
		spi2 = "/soc@0/geniqup@9c0000/spi@988000";
		uart2 = "/soc@0/geniqup@9c0000/serial@988000";
		i2c3 = "/soc@0/geniqup@9c0000/i2c@98c000";
		spi3 = "/soc@0/geniqup@9c0000/spi@98c000";
		i2c4 = "/soc@0/geniqup@9c0000/i2c@990000";
		spi4 = "/soc@0/geniqup@9c0000/spi@990000";
		i2c5 = "/soc@0/geniqup@9c0000/i2c@994000";
		spi5 = "/soc@0/geniqup@9c0000/spi@994000";
		i2c6 = "/soc@0/geniqup@9c0000/i2c@998000";
		spi6 = "/soc@0/geniqup@9c0000/spi@998000";
		i2c7 = "/soc@0/geniqup@9c0000/i2c@99c000";
		spi7 = "/soc@0/geniqup@9c0000/spi@99c000";
		qup1 = "/soc@0/geniqup@ac0000";
		i2c8 = "/soc@0/geniqup@ac0000/i2c@a80000";
		spi8 = "/soc@0/geniqup@ac0000/spi@a80000";
		i2c9 = "/soc@0/geniqup@ac0000/i2c@a84000";
		spi9 = "/soc@0/geniqup@ac0000/spi@a84000";
		i2c10 = "/soc@0/geniqup@ac0000/i2c@a88000";
		spi10 = "/soc@0/geniqup@ac0000/spi@a88000";
		i2c11 = "/soc@0/geniqup@ac0000/i2c@a8c000";
		spi11 = "/soc@0/geniqup@ac0000/spi@a8c000";
		i2c12 = "/soc@0/geniqup@ac0000/i2c@a90000";
		spi12 = "/soc@0/geniqup@ac0000/spi@a90000";
		i2c13 = "/soc@0/geniqup@ac0000/i2c@a94000";
		spi13 = "/soc@0/geniqup@ac0000/spi@a94000";
		i2c14 = "/soc@0/geniqup@ac0000/i2c@a98000";
		spi14 = "/soc@0/geniqup@ac0000/spi@a98000";
		i2c15 = "/soc@0/geniqup@ac0000/i2c@a9c000";
		spi15 = "/soc@0/geniqup@ac0000/spi@a9c000";
		rng = "/soc@0/rng@10d3000";
		pcie4 = "/soc@0/pcie@1c00000";
		pcie4_phy = "/soc@0/phy@1c06000";
		pcie3b = "/soc@0/pcie@1c08000";
		pcie3b_phy = "/soc@0/phy@1c0e000";
		pcie3a = "/soc@0/pcie@1c10000";
		pcie3a_phy = "/soc@0/phy@1c14000";
		pcie2b = "/soc@0/pcie@1c18000";
		pcie2b_phy = "/soc@0/phy@1c1e000";
		pcie2a = "/soc@0/pcie@1c20000";
		pcie2a_phy = "/soc@0/phy@1c24000";
		ufs_mem_hc = "/soc@0/ufs@1d84000";
		ufs_mem_phy = "/soc@0/phy@1d87000";
		ufs_card_hc = "/soc@0/ufs@1da4000";
		ufs_card_phy = "/soc@0/phy@1da7000";
		tcsr_mutex = "/soc@0/hwlock@1f40000";
		tcsr = "/soc@0/syscon@1fc0000";
		gpu = "/soc@0/gpu@3d00000";
		gpu_opp_table = "/soc@0/gpu@3d00000/opp-table";
		gmu = "/soc@0/gmu@3d6a000";
		gmu_opp_table = "/soc@0/gmu@3d6a000/opp-table";
		gpucc = "/soc@0/clock-controller@3d90000";
		gpu_smmu = "/soc@0/iommu@3da0000";
		usb_0_hsphy = "/soc@0/phy@88e5000";
		usb_2_hsphy0 = "/soc@0/phy@88e7000";
		usb_2_hsphy1 = "/soc@0/phy@88e8000";
		usb_2_hsphy2 = "/soc@0/phy@88e9000";
		usb_2_hsphy3 = "/soc@0/phy@88ea000";
		usb_2_qmpphy0 = "/soc@0/phy@88ef000";
		usb_2_qmpphy1 = "/soc@0/phy@88f1000";
		remoteproc_adsp = "/soc@0/remoteproc@3000000";
		remoteproc_adsp_glink = "/soc@0/remoteproc@3000000/glink-edge";
		q6apm = "/soc@0/remoteproc@3000000/glink-edge/gpr/service@1";
		q6apmdai = "/soc@0/remoteproc@3000000/glink-edge/gpr/service@1/dais";
		q6apmbedai = "/soc@0/remoteproc@3000000/glink-edge/gpr/service@1/bedais";
		q6prm = "/soc@0/remoteproc@3000000/glink-edge/gpr/service@2";
		q6prmcc = "/soc@0/remoteproc@3000000/glink-edge/gpr/service@2/clock-controller";
		rxmacro = "/soc@0/rxmacro@3200000";
		swr1 = "/soc@0/soundwire@3210000";
		txmacro = "/soc@0/txmacro@3220000";
		wsamacro = "/soc@0/codec@3240000";
		swr0 = "/soc@0/soundwire@3250000";
		lpass_audiocc = "/soc@0/clock-controller@32a9000";
		swr2 = "/soc@0/soundwire@3330000";
		vamacro = "/soc@0/codec@3370000";
		lpass_tlmm = "/soc@0/pinctrl@33c0000";
		tx_swr_default = "/soc@0/pinctrl@33c0000/tx-swr-default-state";
		rx_swr_default = "/soc@0/pinctrl@33c0000/rx-swr-default-state";
		dmic01_default = "/soc@0/pinctrl@33c0000/dmic01-default-state";
		dmic01_sleep = "/soc@0/pinctrl@33c0000/dmic01-sleep-state";
		dmic02_default = "/soc@0/pinctrl@33c0000/dmic02-default-state";
		dmic02_sleep = "/soc@0/pinctrl@33c0000/dmic02-sleep-state";
		wsa_swr_default = "/soc@0/pinctrl@33c0000/wsa-swr-default-state";
		wsa2_swr_default = "/soc@0/pinctrl@33c0000/wsa2-swr-default-state";
		lpasscc = "/soc@0/clock-controller@33e0000";
		sdc2 = "/soc@0/mmc@8804000";
		sdc2_opp_table = "/soc@0/mmc@8804000/opp-table";
		usb_0_qmpphy = "/soc@0/phy@88eb000";
		usb_0_qmpphy_out = "/soc@0/phy@88eb000/ports/port@0/endpoint";
		usb_0_qmpphy_dp_in = "/soc@0/phy@88eb000/ports/port@2/endpoint";
		usb_1_hsphy = "/soc@0/phy@8902000";
		usb_1_qmpphy = "/soc@0/phy@8903000";
		usb_1_qmpphy_out = "/soc@0/phy@8903000/ports/port@0/endpoint";
		usb_1_qmpphy_dp_in = "/soc@0/phy@8903000/ports/port@2/endpoint";
		mdss1_dp0_phy = "/soc@0/phy@8909a00";
		mdss1_dp1_phy = "/soc@0/phy@890ca00";
		llcc_bwmon_opp_table = "/soc@0/pmu@9091000/opp-table";
		cpu_bwmon_opp_table = "/soc@0/pmu@90b6400/opp-table";
		usb_0 = "/soc@0/usb@a6f8800";
		usb_0_dwc3 = "/soc@0/usb@a6f8800/usb@a600000";
		usb_0_role_switch = "/soc@0/usb@a6f8800/usb@a600000/port/endpoint";
		usb_1 = "/soc@0/usb@a8f8800";
		usb_1_dwc3 = "/soc@0/usb@a8f8800/usb@a800000";
		usb_1_role_switch = "/soc@0/usb@a8f8800/usb@a800000/port/endpoint";
		camcc = "/soc@0/clock-controller@ad00000";
		mdss0 = "/soc@0/display-subsystem@ae00000";
		mdss0_mdp = "/soc@0/display-subsystem@ae00000/display-controller@ae01000";
		mdss0_intf0_out = "/soc@0/display-subsystem@ae00000/display-controller@ae01000/ports/port@0/endpoint";
		mdss0_intf4_out = "/soc@0/display-subsystem@ae00000/display-controller@ae01000/ports/port@4/endpoint";
		mdss0_intf5_out = "/soc@0/display-subsystem@ae00000/display-controller@ae01000/ports/port@5/endpoint";
		mdss0_intf6_out = "/soc@0/display-subsystem@ae00000/display-controller@ae01000/ports/port@6/endpoint";
		mdss0_mdp_opp_table = "/soc@0/display-subsystem@ae00000/display-controller@ae01000/opp-table";
		mdss0_dp0 = "/soc@0/display-subsystem@ae00000/displayport-controller@ae90000";
		mdss0_dp0_in = "/soc@0/display-subsystem@ae00000/displayport-controller@ae90000/ports/port@0/endpoint";
		mdss0_dp0_out = "/soc@0/display-subsystem@ae00000/displayport-controller@ae90000/ports/port@1/endpoint";
		mdss0_dp0_opp_table = "/soc@0/display-subsystem@ae00000/displayport-controller@ae90000/opp-table";
		mdss0_dp1 = "/soc@0/display-subsystem@ae00000/displayport-controller@ae98000";
		mdss0_dp1_in = "/soc@0/display-subsystem@ae00000/displayport-controller@ae98000/ports/port@0/endpoint";
		mdss0_dp1_out = "/soc@0/display-subsystem@ae00000/displayport-controller@ae98000/ports/port@1/endpoint";
		mdss0_dp1_opp_table = "/soc@0/display-subsystem@ae00000/displayport-controller@ae98000/opp-table";
		mdss0_dp2 = "/soc@0/display-subsystem@ae00000/displayport-controller@ae9a000";
		mdss0_dp2_in = "/soc@0/display-subsystem@ae00000/displayport-controller@ae9a000/ports/port@0/endpoint";
		mdss0_dp2_opp_table = "/soc@0/display-subsystem@ae00000/displayport-controller@ae9a000/opp-table";
		mdss0_dp3 = "/soc@0/display-subsystem@ae00000/displayport-controller@aea0000";
		mdss0_dp3_in = "/soc@0/display-subsystem@ae00000/displayport-controller@aea0000/ports/port@0/endpoint";
		mdss0_dp3_out = "/soc@0/display-subsystem@ae00000/displayport-controller@aea0000/ports/port@1/endpoint";
		mdss0_dp3_opp_table = "/soc@0/display-subsystem@ae00000/displayport-controller@aea0000/opp-table";
		edp_panel_in = "/soc@0/display-subsystem@ae00000/displayport-controller@aea0000/aux-bus/panel/port/endpoint";
		mdss0_dp2_phy = "/soc@0/phy@aec2a00";
		mdss0_dp3_phy = "/soc@0/phy@aec5a00";
		dispcc0 = "/soc@0/clock-controller@af00000";
		pdc = "/soc@0/interrupt-controller@b220000";
		tsens0 = "/soc@0/thermal-sensor@c263000";
		tsens1 = "/soc@0/thermal-sensor@c265000";
		aoss_qmp = "/soc@0/power-management@c300000";
		spmi_bus = "/soc@0/spmi@c440000";
		pmk8280 = "/soc@0/spmi@c440000/pmic@0";
		pmk8280_pon = "/soc@0/spmi@c440000/pmic@0/pon@1300";
		pmk8280_pon_pwrkey = "/soc@0/spmi@c440000/pmic@0/pon@1300/pwrkey";
		pmk8280_pon_resin = "/soc@0/spmi@c440000/pmic@0/pon@1300/resin";
		pmk8280_vadc = "/soc@0/spmi@c440000/pmic@0/adc@3100";
		pmk8280_adc_tm = "/soc@0/spmi@c440000/pmic@0/adc-tm@3400";
		pmk8280_rtc = "/soc@0/spmi@c440000/pmic@0/rtc@6100";
		pmk8280_sdam_6 = "/soc@0/spmi@c440000/pmic@0/nvram@8500";
		rtc_offset = "/soc@0/spmi@c440000/pmic@0/nvram@8500/rtc-offset@bc";
		pmc8280_1 = "/soc@0/spmi@c440000/pmic@1";
		pm8280_1_temp_alarm = "/soc@0/spmi@c440000/pmic@1/temp-alarm@a00";
		pmc8280_1_gpios = "/soc@0/spmi@c440000/pmic@1/gpio@8800";
		edp_bl_en = "/soc@0/spmi@c440000/pmic@1/gpio@8800/edp-bl-en-state";
		edp_bl_reg_en = "/soc@0/spmi@c440000/pmic@1/gpio@8800/edp-bl-reg-en-state";
		misc_3p3_reg_en = "/soc@0/spmi@c440000/pmic@1/gpio@8800/misc-3p3-reg-en-state";
		pmc8280c = "/soc@0/spmi@c440000/pmic@2";
		pmc8280c_gpios = "/soc@0/spmi@c440000/pmic@2/gpio@8800";
		edp_bl_pwm = "/soc@0/spmi@c440000/pmic@2/gpio@8800/edp-bl-pwm-state";
		pmc8280c_lpg = "/soc@0/spmi@c440000/pmic@2/pwm";
		pmc8280_2 = "/soc@0/spmi@c440000/pmic@3";
		pm8280_2_temp_alarm = "/soc@0/spmi@c440000/pmic@3/temp-alarm@a00";
		pmc8280_2_gpios = "/soc@0/spmi@c440000/pmic@3/gpio@8800";
		wwan_sw_en = "/soc@0/spmi@c440000/pmic@3/gpio@8800/wwan-sw-en-state";
		pmr735a = "/soc@0/spmi@c440000/pmic@4";
		pmr735a_gpios = "/soc@0/spmi@c440000/pmic@4/gpio@8800";
		hastings_reg_en = "/soc@0/spmi@c440000/pmic@4/gpio@8800/hastings-reg-en-state";
		tlmm = "/soc@0/pinctrl@f100000";
		edp_reg_en = "/soc@0/pinctrl@f100000/edp-reg-en-state";
		i2c4_default = "/soc@0/pinctrl@f100000/i2c4-default-state";
		i2c21_default = "/soc@0/pinctrl@f100000/i2c21-default-state";
		kybd_default = "/soc@0/pinctrl@f100000/kybd-default-state";
		nvme_reg_en = "/soc@0/pinctrl@f100000/nvme-reg-en-state";
		pcie2a_default = "/soc@0/pinctrl@f100000/pcie2a-default-state";
		pcie3a_default = "/soc@0/pinctrl@f100000/pcie3a-default-state";
		pcie4_default = "/soc@0/pinctrl@f100000/pcie4-default-state";
		sdc2_default_state = "/soc@0/pinctrl@f100000/sdc2-default-state";
		sdc2_sleep_state = "/soc@0/pinctrl@f100000/sdc2-sleep-state";
		tpad_default = "/soc@0/pinctrl@f100000/tpad-default-state";
		ts0_default = "/soc@0/pinctrl@f100000/ts0-default-state";
		usb0_sbu_default = "/soc@0/pinctrl@f100000/usb0-sbu-state";
		usb1_sbu_default = "/soc@0/pinctrl@f100000/usb1-sbu-state";
		apps_smmu = "/soc@0/iommu@15000000";
		intc = "/soc@0/interrupt-controller@17a00000";
		apps_rsc = "/soc@0/rsc@18200000";
		apps_bcm_voter = "/soc@0/rsc@18200000/bcm-voter";
		rpmhcc = "/soc@0/rsc@18200000/clock-controller";
		rpmhpd = "/soc@0/rsc@18200000/power-controller";
		rpmhpd_opp_table = "/soc@0/rsc@18200000/power-controller/opp-table";
		rpmhpd_opp_ret = "/soc@0/rsc@18200000/power-controller/opp-table/opp1";
		rpmhpd_opp_min_svs = "/soc@0/rsc@18200000/power-controller/opp-table/opp2";
		rpmhpd_opp_low_svs = "/soc@0/rsc@18200000/power-controller/opp-table/opp3";
		rpmhpd_opp_svs = "/soc@0/rsc@18200000/power-controller/opp-table/opp4";
		rpmhpd_opp_svs_l1 = "/soc@0/rsc@18200000/power-controller/opp-table/opp5";
		rpmhpd_opp_nom = "/soc@0/rsc@18200000/power-controller/opp-table/opp6";
		rpmhpd_opp_nom_l1 = "/soc@0/rsc@18200000/power-controller/opp-table/opp7";
		rpmhpd_opp_nom_l2 = "/soc@0/rsc@18200000/power-controller/opp-table/opp8";
		rpmhpd_opp_turbo = "/soc@0/rsc@18200000/power-controller/opp-table/opp9";
		rpmhpd_opp_turbo_l1 = "/soc@0/rsc@18200000/power-controller/opp-table/opp10";
		vreg_s11b = "/soc@0/rsc@18200000/regulators-0/smps11";
		vreg_l3b = "/soc@0/rsc@18200000/regulators-0/ldo3";
		vreg_l4b = "/soc@0/rsc@18200000/regulators-0/ldo4";
		vreg_l6b = "/soc@0/rsc@18200000/regulators-0/ldo6";
		vreg_l1c = "/soc@0/rsc@18200000/regulators-1/ldo1";
		vreg_l6c = "/soc@0/rsc@18200000/regulators-1/ldo6";
		vreg_l7c = "/soc@0/rsc@18200000/regulators-1/ldo7";
		vreg_l9c = "/soc@0/rsc@18200000/regulators-1/ldo9";
		vreg_l13c = "/soc@0/rsc@18200000/regulators-1/ldo13";
		vreg_l3d = "/soc@0/rsc@18200000/regulators-2/ldo3";
		vreg_l4d = "/soc@0/rsc@18200000/regulators-2/ldo4";
		vreg_l6d = "/soc@0/rsc@18200000/regulators-2/ldo6";
		vreg_l7d = "/soc@0/rsc@18200000/regulators-2/ldo7";
		vreg_l9d = "/soc@0/rsc@18200000/regulators-2/ldo9";
		epss_l3 = "/soc@0/interconnect@18590000";
		cpufreq_hw = "/soc@0/cpufreq@18591000";
		remoteproc_nsp0 = "/soc@0/remoteproc@1b300000";
		remoteproc_nsp1 = "/soc@0/remoteproc@21300000";
		mdss1 = "/soc@0/display-subsystem@22000000";
		mdss1_mdp = "/soc@0/display-subsystem@22000000/display-controller@22001000";
		mdss1_intf0_out = "/soc@0/display-subsystem@22000000/display-controller@22001000/ports/port@0/endpoint";
		mdss1_intf4_out = "/soc@0/display-subsystem@22000000/display-controller@22001000/ports/port@4/endpoint";
		mdss1_intf5_out = "/soc@0/display-subsystem@22000000/display-controller@22001000/ports/port@5/endpoint";
		mdss1_intf6_out = "/soc@0/display-subsystem@22000000/display-controller@22001000/ports/port@6/endpoint";
		mdss1_mdp_opp_table = "/soc@0/display-subsystem@22000000/display-controller@22001000/opp-table";
		mdss1_dp0 = "/soc@0/display-subsystem@22000000/displayport-controller@22090000";
		mdss1_dp0_in = "/soc@0/display-subsystem@22000000/displayport-controller@22090000/ports/port@0/endpoint";
		mdss1_dp0_opp_table = "/soc@0/display-subsystem@22000000/displayport-controller@22090000/opp-table";
		mdss1_dp1 = "/soc@0/display-subsystem@22000000/displayport-controller@22098000";
		mdss1_dp1_in = "/soc@0/display-subsystem@22000000/displayport-controller@22098000/ports/port@0/endpoint";
		mdss1_dp1_opp_table = "/soc@0/display-subsystem@22000000/displayport-controller@22098000/opp-table";
		mdss1_dp2 = "/soc@0/display-subsystem@22000000/displayport-controller@2209a000";
		mdss1_dp2_in = "/soc@0/display-subsystem@22000000/displayport-controller@2209a000/ports/port@0/endpoint";
		mdss1_dp2_opp_table = "/soc@0/display-subsystem@22000000/displayport-controller@2209a000/opp-table";
		mdss1_dp3 = "/soc@0/display-subsystem@22000000/displayport-controller@220a0000";
		mdss1_dp3_in = "/soc@0/display-subsystem@22000000/displayport-controller@220a0000/ports/port@0/endpoint";
		mdss1_dp3_opp_table = "/soc@0/display-subsystem@22000000/displayport-controller@220a0000/opp-table";
		mdss1_dp2_phy = "/soc@0/phy@220c2a00";
		mdss1_dp3_phy = "/soc@0/phy@220c5a00";
		dispcc1 = "/soc@0/clock-controller@22100000";
		ethernet1 = "/soc@0/ethernet@23000000";
		sound = "/sound";
		pm8280_1_thermal = "/thermal-zones/pm8280-1-thermal";
		pm8280_2_thermal = "/thermal-zones/pm8280-2-thermal";
		backlight = "/backlight";
		pmic_glink_con0_hs = "/pmic-glink/connector@0/ports/port@0/endpoint";
		pmic_glink_con0_ss = "/pmic-glink/connector@0/ports/port@1/endpoint";
		pmic_glink_con0_sbu = "/pmic-glink/connector@0/ports/port@2/endpoint";
		pmic_glink_con1_hs = "/pmic-glink/connector@1/ports/port@0/endpoint";
		pmic_glink_con1_ss = "/pmic-glink/connector@1/ports/port@1/endpoint";
		pmic_glink_con1_sbu = "/pmic-glink/connector@1/ports/port@2/endpoint";
		vreg_edp_3p3 = "/regulator-edp-3p3";
		vreg_edp_bl = "/regulator-edp-bl";
		vreg_nvme = "/regulator-nvme";
		vreg_misc_3p3 = "/regulator-misc-3p3";
		vreg_wlan = "/regulator-wlan";
		vreg_wwan = "/regulator-wwan";
		usb0_sbu_mux = "/usb0-sbu-mux/port/endpoint";
		usb1_sbu_mux = "/usb1-sbu-mux/port/endpoint";
	};
};
